#include <SPI.h>
#include <Wire.h>
#include <Adafruit_GFX.h>
#include <Adafruit_SSD1306.h>
#include <Button.h>
#include <Ethernet.h>
#include <HttpClient.h>
#include <string.h> 

// Ethernet module settings
byte mac[] = {0xDE, 0xAD, 0xBE, 0xEF, 0xFE, 0xED};  // MAC address
EthernetClient client;

// ChatGPT API endpoint and parameters
const char* apiEndpoint = "xxxxxxxxxxxxxxxxxxxxxxxxxxxxxxxxxxxxxxxxxxxxxxxxxxxxxxxxxxxxx";  //Replace with your api endpoint
const char* apiKey = "xxxxxxxxxxxxxxxxxxxxxxxxxxxxxxxxxxxxxxxxxxxxxxxxxxxxxxx";  //Replace with your api key
const int contentLength = 100;  // Adjust the content length based on the prompt length

#define SCREEN_WIDTH 128 // OLED display width, in pixels
#define SCREEN_HEIGHT 32 // OLED display height, in pixels

#define OLED_RESET     -1 // Reset pin # (or -1 if sharing Arduino reset pin)
#define SCREEN_ADDRESS 0x3C ///< See datasheet for Address; 0x3D for 128x64, 0x3C for 128x32
Adafruit_SSD1306 display(SCREEN_WIDTH, SCREEN_HEIGHT, &Wire, OLED_RESET);

// Timer settings
const int questionTimeout = 30000;  // 30 seconds

struct QuizQuestion {
  const char* question;
  const char* correctAnswer;
};

const int numQuestions = 10;
QuizQuestion quizQuestions[numQuestions];

int currentQuestionIndex = 0;
int playerScore = 0;

// Button pins
Button button1(PG5); // Connect your button between pin 2 and GND
Button button2(PG8); // Connect your button between pin 3 and GND
Button button3(PE0); // Connect your button between pin 4 and GND
Button button4(PF11); // Connect your button between pin 4 and GND

void setup() {
  button1.begin();
  button2.begin();
  button3.begin();
  button4.begin();

  Serial.begin(9600);

  if (!display.begin(SSD1306_SWITCHCAPVCC, SCREEN_ADDRESS)) {
    Serial.println(F("SSD1306 allocation failed"));
    for (;;); // Don't proceed, loop forever
  }

  display.setRotation(2);  // Rotate the display content by 180 degrees

  // Show initial display buffer contents on the screen --
  // the library initializes this with an Adafruit splash screen.
  display.display();
  delay(1); // Pause for 2 seconds
  
  // Initialize Ethernet module
  Ethernet.begin(mac);
  delay(1000);
  display.clearDisplay();   // Clear the buffer
  printlogo();
  delay(2000);
  introtext();
  delay(2000);
}

void loop() {
  displayQuestion();

  unsigned long startTime = millis();

  while (millis() - startTime < questionTimeout) {
    if (button1.pressed()) {
      handleAnswer("A");
      break;
    } else if (button2.pressed()) {
      handleAnswer("B");
      break;
    } else if (button3.pressed()) {
      handleAnswer("C");
      break;
    } else if (button4.pressed()) {
      handleAnswer("D");
      break;
    }
  }
}

void testdrawstyles(void) {
  display.clearDisplay();

  display.setTextSize(1);             // Normal 1:1 pixel scale
  display.setTextColor(SSD1306_WHITE);        // Draw white text
  display.setCursor(0, 0);            // Start at top-left corner
  display.println(F("Hello, world!"));

  display.setTextColor(SSD1306_BLACK, SSD1306_WHITE); // Draw 'inverse' text
  display.println(3.141592);

  display.setTextSize(1);             // Draw 2X-scale text
  display.setTextColor(SSD1306_WHITE);
  display.print(F("0x")); display.println(0xDEADBEEF, HEX);

  display.display();
  delay(2000);
}

void testscrolltext(void) {
  display.clearDisplay();

  display.setTextSize(1); // Draw 2X-scale text
  display.setTextColor(SSD1306_WHITE);
  display.setCursor(10, 0);
  display.println(F("scroll"));
  display.display();      // Show initial text
  delay(100);

  // Scroll in various directions, pausing in-between:
  display.startscrollright(0x00, 0x0F);
  delay(2000);
  display.stopscroll();
  delay(1000);
  display.startscrollleft(0x00, 0x0F);
  delay(2000);
  display.stopscroll();
  delay(1000);
  display.startscrolldiagright(0x00, 0x07);
  delay(2000);
  display.startscrolldiagleft(0x00, 0x07);
  delay(2000);
  display.stopscroll();
  delay(1000);
}

void introtext(void) {
  display.clearDisplay();

  display.setTextSize(1); // Draw 2X-scale text
  display.setTextColor(SSD1306_WHITE);
  display.setCursor(25, 0);
  display.println("QuizMaster");
  display.println("ChatGPT - Driven Quiz");
  display.println("");
  display.println("YouTube @rahul-khanna");

  display.display();      // Show initial text

  delay(1000); // Adjust the delay time to control scrolling speed
  display.clearDisplay();
  /*

    // Scroll the text from right to left
    for (int16_t x = display.width(); x >= -display.width(); x--) {
    display.clearDisplay();
    display.setCursor(x, 0);
    display.println("QuizMaster - ChatGPT - Driven Quiz Game");
    display.display();
    }
  */
}

static const unsigned char PROGMEM image_data_Image[] = {
  0xff, 0x00, 0x00, 0x00, 0xff, 0x00, 0x00, 0x00, 0xff, 0x00, 0x00, 0x00,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 0x00,
  0xff, 0x00, 0x00, 0x00, 0xff, 0x00, 0x00, 0x00, 0xff, 0x00, 0x00, 0x00,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 0x00,
  0xff, 0x00, 0x00, 0x00, 0xff, 0x00, 0x00, 0x00, 0xff, 0x00, 0x00, 0x00,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 0x00,
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  0xff, 0x00, 0x00, 0x00, 0xff, 0x00, 0x00, 0x00, 0xff, 0x00, 0x00, 0x00,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 0x00
};

void printlogo(void) {
  // Clear the buffer.
  display.clearDisplay();

  // Draw bitmap on the screen
  display.drawBitmap(0, 0, image_data_Image, 65, 64, 8);
  display.display();
}

// Function to display text on the OLED screen
void displayText(const char* text) {
  display.clearDisplay();
  display.setTextSize(1);
  display.setTextColor(WHITE);
  display.setCursor(0, 0);
  display.println(text);
  display.display();
}

void bttest() {
  while (1) {
    if (button1.pressed()) {
      // Display the countdown timer
      display.clearDisplay();
      display.setTextSize(1);
      display.setTextColor(WHITE);
      display.setCursor(0, 0);
      display.print("1");
      display.display();
    }
    if (button2.pressed()) {
      // Display the countdown timer
      display.clearDisplay();
      display.setTextSize(1);
      display.setTextColor(WHITE);
      display.setCursor(0, 0);
      display.print("2");
      display.display();
    }
    if (button3.pressed()) {
      // Display the countdown timer
      display.clearDisplay();
      display.setTextSize(1);
      display.setTextColor(WHITE);
      display.setCursor(0, 0);
      display.print("3");
      display.display();
    }
    if (button4.pressed()) {
      // Display the countdown timer
      display.clearDisplay();
      display.setTextSize(1);
      display.setTextColor(WHITE);
      display.setCursor(0, 0);
      display.print("4");
      display.display();
    }
  }
}

// Function to retrieve a quiz question from ChatGPT API
String getQuizQuestion() {
  if (client.connect(apiEndpoint, 443)) {
    String payload = "Generate a quiz question with four options and give the correct option number";
    
    client.println("POST " + String(apiEndpoint) + " HTTP/1.1");
    client.println("Host: api.openai.com");
    client.println("Authorization: Bearer " + String(apiKey));
    client.println("Content-Type: application/json");
    client.println("Content-Length: " + String(contentLength + payload.length()));
    client.println();
    client.println(payload);
    
    // Wait for response from ChatGPT API
    while (!client.available()) {
      delay(100);
    }
    
    // Read and return the response
    String response = client.readStringUntil('\r');
    client.stop();
    return response;
  } else {
    return "Error connecting to ChatGPT API";
  }
}

void displayQuestion() {
  String data = getQuizQuestion();
  int MyI = data.indexOf(";");
  String ques = data.substring(0, MyI);
  int ans = data.lastIndexOf("\"", MyI + 1);
  quizQuestions[currentQuestionIndex].question = ques.c_str(); 
  quizQuestions[currentQuestionIndex].correctAnswer = String(ans).c_str();
  displayText(quizQuestions[currentQuestionIndex].question);
}


void displayScore() {
  displayText("Score : " + int(playerScore));
  delay(2000);  // Show the score for 2 seconds
}

void displayScore1() {
  display.clearDisplay();
  display.setTextSize(1);
  display.setTextColor(WHITE);
  display.setCursor(0, 0);
  display.println("Correct Answer!");
  display.print("Score: ");
  display.print(playerScore);
  display.display();
  delay(2000);  // Show the score for 2 seconds
}

void gameOver() {
  display.clearDisplay();
  display.setTextSize(1);
  display.setTextColor(WHITE);
  display.setCursor(0, 0);
  display.println("Game Over!");
  display.print("Final Score: ");
  display.print(playerScore);
  display.display();
  
  delay(5000);  // Show the game over message for 5 seconds
  playerScore = 0;  // Reset player score
  currentQuestionIndex = 0;  // Reset question index
  while (1);
}

void handleAnswer(const String& selectedAnswer) {
  if (selectedAnswer == quizQuestions[currentQuestionIndex].correctAnswer) {
    playerScore++;
    displayScore1();
    
    delay(2000);  // Show the correct answer for 2 seconds
  } else {
    gameOver();
  }

  currentQuestionIndex++;

  if (currentQuestionIndex < numQuestions) {
    displayQuestion();
  } else {
    displayScore();
    gameOver();
  }
}
